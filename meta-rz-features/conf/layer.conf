## meta-rz-features/conf/layer.conf
```bitbake
# We have a conf and classes directory, add to BBPATH

include ${LAYERDIR}/include/mali/feature.inc
include ${LAYERDIR}/include/codec/plugin.inc

BBPATH .= ":${LAYERDIR}"

BBFILE_COLLECTIONS += "rz-features"
BBFILE_PATTERN_rz-features := "^${LAYERDIR}/"

# We have recipes-* directories, add to BBFILES
BBFILES += "${LAYERDIR}/recipes-*/*/*.bb \
    ${LAYERDIR}/recipes-*/*.bb \
    ${LAYERDIR}/recipes-*/*.bbappend \
    ${LAYERDIR}/recipes-*/*/*.bbappend"
```
